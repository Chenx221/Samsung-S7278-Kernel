## drivers/sensors/Kconfig
```kconfig
menuconfig NEW_SENSORS
	bool "Sensors Support"
	help
		Say Y to enable Sensors support. This allows control of supported
		Sensors.

config SENSORS_BMA254
	tristate "BMA254 Acceleration Sensor Driver"
	depends on I2C
	default n
	help
	  If you say yes here you get support for Bosch-Sensortec's
	  BMA254 Acceleration Sensor.

config INPUT_BMA254_ACC_ALERT_INT
	tristate "BMA254 acceleration sensor motion support"
	depends on SENSORS_BMA254
	default n
	help
	  If you say yes here you get support for Bosch Sensortec's 
	  acceleration sensors BMA254 Motion support.	


if NEW_SENSORS
source "drivers/sensors/core/Kconfig"
endif
```
